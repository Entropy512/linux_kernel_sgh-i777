## arch/arm/plat-s5p/Kconfig
```kconfig
# arch/arm/plat-s5p/Kconfig
#
# Copyright (c) 2009 Samsung Electronics Co., Ltd.
#		http://www.samsung.com/
#
# Licensed under GPLv2

config PLAT_S5P
	bool
	depends on (ARCH_S5P6440 || ARCH_S5P6442 || ARCH_S5P6450 || ARCH_S5PC100 || ARCH_S5PV210 || ARCH_S5PV310)
	default y
	select ARM_VIC if !ARCH_S5PV310
	select ARM_GIC if ARCH_S5PV310
	select NO_IOPORT
	select ARCH_REQUIRE_GPIOLIB
	select S3C_GPIO_TRACK
	select S5P_GPIO_DRVSTR
	select S5P_GPIO_CONPDN
	select S5P_GPIO_PUDPDN
	select SAMSUNG_GPIOLIB_4BIT
	select S3C_GPIO_CFG_S3C64XX
	select S3C_GPIO_PULL_UPDOWN
	select S3C_GPIO_CFG_S3C24XX
	select PLAT_SAMSUNG
	select SAMSUNG_CLKSRC
	select SAMSUNG_IRQ_VIC_TIMER
	select SAMSUNG_IRQ_UART
	help
	  Base platform code for Samsung's S5P series SoC.

config S5P_EXT_INT
	bool
	help
	  Use the external interrupts (other than GPIO interrupts.)
	  Note: Do not choose this for S5P6440.

# MFC part
config S5P_DEV_MFC
	bool
	depends on (VIDEO_MFC50)
	default y
	help
	  Compile in platform device definitions for MFC

config S5P_SETUP_MFC
	bool
	depends on (VIDEO_MFC5X || VIDEO_MFC50)
	default y
	help
	  Common setup code for MFC

choice
	prompt "Fixed Memory Support"
	default S5P_MEM_CMA if ARCH_S5PV310
	default S5P_MEM_BOOTMEM if (ARCH_S5P6440 || ARCH_S5P6442 || ARCH_S5P6450|| ARCH_S5PC100 || ARCH_S5PV210)
config S5P_MEM_CMA
        bool "Fixed memory through CMA"
	select CMA
        help
          Use CMA(Contiguous memory allocator) to reserve machine specific memory.

config S5P_MEM_BOOTMEM
        bool "Fixed memory through Bootmem"
        help
          Use bootmem to reserve machine specific memory.
endchoice

menuconfig S5P_SYSMMU
        bool "SYSMMU support"
	depends on ARCH_S5PV310
        help
	  This is a System MMU driver for Samsung ARM based Soc.

if S5P_SYSMMU

config S5P_SYSMMU_MDMA1
	bool "support System MMU for MDMA1"
	help
	  support System MMU for MDMA1

config S5P_SYSMMU_SSS
	bool "support System MMU for SSS"
	help
	  support System MMU for SSS

config S5P_SYSMMU_FIMC0
	bool "support System MMU for FIMC0"
	help
	  support System MMU for FIMC0

config S5P_SYSMMU_FIMC1
	bool "support System MMU for FIMC1"
	help
	  support System MMU for FIMC1

config S5P_SYSMMU_FIMC2
	bool "support System MMU for FIMC2"
	help
	  support System MMU for FIMC2

config S5P_SYSMMU_FIMC3
	bool "support System MMU for FIMC3"
	help
	  support System MMU for FIMC3

config S5P_SYSMMU_JPEG
	bool "support System MMU for JPEG"
	help
	  support System MMU for JPEG

config S5P_SYSMMU_FIMD0
	bool "support System MMU for FIMD0"
	help
	  support System MMU for FIMD0

config S5P_SYSMMU_FIMD1
	bool "support System MMU for FIMD1"
	help
	  support System MMU for FIMD1

config S5P_SYSMMU_PCIe
	bool "support System MMU for PCIe"
	help
	  support System MMU for PCIe

config S5P_SYSMMU_FIMG2D
	bool "support System MMU for FIMG2D"
	help
	  support System MMU for FIMG2D

config S5P_SYSMMU_ROTATOR
	bool "support System MMU for ROTATOR"
	help
	  support System MMU for ROTATOR

config S5P_SYSMMU_MDMA2
	bool "support System MMU for MDMA2"
	help
	  support System MMU for MDMA2

config S5P_SYSMMU_TV
	bool "support System MMU for TV"
	help
	  support System MMU for TV

config S5P_SYSMMU_MFC_L
	bool "support System MMU for MFC_L"
	help
	  support System MMU for MFC_L

config S5P_SYSMMU_MFC_R
	bool "support System MMU for MFC_R"
	help
	  support System MMU for MFC_R

config S5P_SYSMMU_DEBUG
        bool "Enables debug messages"
	depends on S5P_SYSMMU
        help
          This enables SYSMMU driver debug massages.

endif
```

## drivers/dpram/Kconfig
```kconfig
#
# IDPRAM configuration
#

menuconfig SAMSUNG_PHONE_TTY
        tristate "Samsung Phone Interface - TTY"
        default y
        ---help---
          By default, y
          When in doubt, say N.

if SAMSUNG_PHONE_TTY

config  SAMSUNG_PHONE_TTY_RAFFAELLO
        tristate "Select Samsung Phone Interface - TTY for Raffaello"
        depends on SAMSUNG_PHONE_TTY

config  SAMSUNG_PHONE_TTY_RAFFAELLO_RECOVERY
        tristate "Select Samsung Phone Interface - TTY for Raffaello"
        depends on SAMSUNG_PHONE_TTY

endif # SAMSUNG_PHONE_TTY
```

## drivers/gib/Kconfig
```kconfig
#
# GIB driver configuration
#

menuconfig GPS
        tristate "GPS support"
        depends on MACH_SMDK6450 || MACH_SMDKC210 || MACH_SMDKV310 || MACH_C1
if GPS
config GIB
	bool "GIB support"

config GIB_DEBUG
	boolean "Debug support for GIB drivers"
	depends on GIB && DEBUG_KERNEL
	help
	  Say "yes" to enable debug messaging (like dev_dbg and pr_debug),
	  sysfs, and debugfs support in GIB controller and protocol drivers.

#
# MASTER side ... talking to discrete GIB slave chips including microcontrollers
#
config GIB_S5P64XX
        tristate "S5P64XX GIB Driver"
        depends on GIB && MACH_SMDK6450
        help
          Say Y here to include support for GIB controller in the
          Samsung S5P6450 based System-on-Chip devices.


config GIB_S5PV3XX
        tristate "S5PV3XX GIB Driver"
        depends on GIB && (MACH_SMDKV310 || MACH_SMDKC210 || MACH_C1)
        help
          Say Y here to include support for GIB controller in the
          Samsung S5PV310 based System-on-Chip devices.

endif
```

## drivers/media/video/samsung/Kconfig
```kconfig
config VIDEO_SAMSUNG
	bool "Samsung Multimedia Devices"
	depends on VIDEO_CAPTURE_DRIVERS && VIDEO_V4L2
	select VIDEO_FIXED_MINOR_RANGES
	default n
	help
	  This is a representative video4linux configuration for Samsung multimedia devices.

config VIDEO_SAMSUNG_V4L2
	bool "V4L2 API for digital camera to be contributed by samsung"
	depends on VIDEO_DEV && VIDEO_SAMSUNG
	default n
	help
	  This feature is for new V4L2 APIs all about digital camera

if CPU_S5PV210 || CPU_S5P6450 || CPU_S5PV310
source "drivers/media/video/samsung/fimc/Kconfig"
source "drivers/media/video/samsung/rotator/Kconfig"
endif

if CPU_S5PV310
source "drivers/media/video/samsung/tvout/Kconfig"
endif

if CPU_S5PV210 || CPU_S5P6450
source "drivers/media/video/samsung/jpeg_v2/Kconfig"
endif

#source "drivers/media/video/samsung/mfc50/Kconfig"
source "drivers/media/video/samsung/mfc5x/Kconfig"


if CPU_S5PV210 || CPU_S5PV310
source "drivers/media/video/samsung/fimg2d_android/Kconfig"
source "drivers/media/video/samsung/jpeg/Kconfig"
endif

if CPU_S5PV310
source "drivers/media/video/samsung/mali/Kconfig"
source "drivers/media/video/samsung/ump/Kconfig"
source "drivers/media/video/samsung/mhl_v1/Kconfig"
source "drivers/media/video/samsung/tsi/Kconfig"
endif

if VIDEO_SAMSUNG
comment "Reserved memory configurations"
config VIDEO_SAMSUNG_MEMSIZE_FIMC0
	int "Memory size in kbytes for FIMC0"
	depends on VIDEO_FIMC
	default "5120"

config VIDEO_SAMSUNG_MEMSIZE_FIMC1
	int "Memory size in kbytes for FIMC1"
	depends on VIDEO_FIMC
	default "5120"

config VIDEO_SAMSUNG_MEMSIZE_FIMC2
	int "Memory size in kbytes for FIMC2"
	depends on VIDEO_FIMC
	default "5120"

if CPU_S5PV310
config VIDEO_SAMSUNG_MEMSIZE_FIMC3
	int "Memory size in kbytes for FIMC3"
	depends on VIDEO_FIMC && CPU_S5PV310
	default "5120"
endif


config VIDEO_SAMSUNG_MEMSIZE_MFC0
	int "Memory size in kbytes for MFC port0"
	depends on (VIDEO_MFC50 || VIDEO_MFC5X) && (!VIDEO_MFC_MEM_PORT_COUNT = 1)
	default "32768"

config VIDEO_SAMSUNG_MEMSIZE_MFC1
	int "Memory size in kbytes for MFC port1"
	depends on (VIDEO_MFC50 || VIDEO_MFC5X) && (!VIDEO_MFC_MEM_PORT_COUNT = 1)
	default "32768"

config VIDEO_SAMSUNG_MEMSIZE_JPEG
	int "Memory size in kbytes for JPEG"
	depends on VIDEO_JPEG
	default "8192"

config VIDEO_SAMSUNG_MEMSIZE_FIMG2D
       int "Memory size in kbytes for FIMG2D"
       depends on VIDEO_FIMG2D
       default "8192"

config VIDEO_SAMSUNG_MEMSIZE_TV
        int "Memory size in kbytes for TV"
        depends on VIDEO_TV
        default "8192"
endif
```

## drivers/media/video/samsung/fimc/Kconfig
```kconfig
config VIDEO_FIMC
	bool "Samsung Camera Interface (FIMC) driver"
	depends on VIDEO_SAMSUNG && (ARCH_S5PV210 || ARCH_S5P6450 || ARCH_S5PV310)
	select VIDEO_IPC if ARCH_S5PV210
	default n
	help
	  This is a video4linux driver for Samsung FIMC device.

choice
depends on VIDEO_FIMC
prompt "Select CSC Range config"
default VIDEO_FIMC_RANGE_NARROW
config VIDEO_FIMC_RANGE_NARROW
	bool "Narrow"
	depends on VIDEO_FIMC && (ARCH_S5PV210 || ARCH_S5PV310)
	---help---
	  RGB <-> YUV Color Conversion Narrow Range Equation

config VIDEO_FIMC_RANGE_WIDE
	bool "Wide"
	depends on VIDEO_FIMC && (ARCH_S5PV210 || ARCH_S5PV310)
	---help---
	  RGB <-> YUV Color Conversion Wide Range Equation
endchoice

config VIDEO_IPC
	bool

config VIDEO_FIMC_DEBUG
	bool "FIMC driver debug messages"
	depends on VIDEO_FIMC

config VIDEO_FIMC_MIPI
	bool "MIPI-CSI2 Slave Interface support"
	depends on VIDEO_FIMC && (ARCH_S5PV210 || ARCH_S5PV310)
	default y

config VIDEO_FIMC_UMP_VCM_CMA
	bool "Support UMP over VCM with CMA for FIMC"
	depends on VIDEO_FIMC && VCM_MMU && VIDEO_UMP && CMA && VCM
	default y

choice
depends on VIDEO_FIMC && ARCH_S5PV310
prompt "Select ITU / MIPI Camera port"
default ITU_A
config ITU_A
	bool "ITU Camera A port"
	help
	  This enables support for ITU A port
config ITU_B
	bool "ITU Camera B port"
	help
	  This enables support for ITU B port
config CSI_C
	bool "CSI Camera A port"
	help
	  This enables support for CSI A port
config CSI_D
	bool "CSI Camera B port"
	help
	  This enables support for CSI B port
endchoice

choice
depends on VIDEO_FIMC
prompt "Select Output Mode"
default VIDEO_FIMC_DMA_AUTO
config VIDEO_FIMC_DMA_AUTO
        bool "DMA AUTO MODE"
        depends on VIDEO_FIMC
        help
          This enables support for FIMC1 DMA AUTO mode

config VIDEO_FIMC_FIFO
        bool "FIFO MODE"
        depends on VIDEO_FIMC
        help
          This enables support for FIMC1 FIFO mode

endchoice
```

## drivers/media/video/samsung/fimg2d/Kconfig
```kconfig
# drivers/media/video/samsung/fimg2d/Kconfig
#
# Copyright (c) 2010 Samsung Electronics Co., Ltd.
#	http://www.samsung.com/
#
# Licensed under GPLv2

config VIDEO_FIMG2D
	bool "Samsung Graphics 2D Driver"
	depends on VIDEO_SAMSUNG && (CPU_S5PV210 || CPU_S5PV310)
	help
	  This is a graphics 2D (FIMG2D) driver for Samsung ARM based SoC.

config VIDEO_FIMG2D_DEBUG
	bool "Enables debug messages"
	depends on VIDEO_FIMG2D
	help
	  This enables FIMG2D driver debug messages.
```

## drivers/media/video/samsung/fimg2d_android/Kconfig
```kconfig
# drivers/media/video/samsung/g2d/Kconfig
#
# Copyright (c) 2010 Samsung Electronics Co., Ltd.
# 		http://www.samsung.com/
#
# Licensed under GPLv2

config VIDEO_FIMG2D
	bool "Samsung FIMG-2D Driver"
	depends on VIDEO_SAMSUNG && (CPU_S5PV210 || CPU_S5PV310) && S5P_SYSMMU
	default y
	help
	  This is a graphics 2D (FIMG2D) driver for Samsung S5PV310.

config VIDEO_FIMG2D_DEBUG
	bool "G2D Driver Debug Messages"
	depends on VIDEO_FIMG2D
	default n
	help
	  This enables G2D driver debug messages.
```

## drivers/media/video/samsung/mhl_v1/Kconfig
```kconfig
#
# Copyright (c) 2010 Samsung Electronics Co., Ltd.
# 		http://www.samsung.com/
# Aakash Manik
#	aakash.manik@samsung.com
# Licensed under GPLv2

config VIDEO_MHL_V1
	bool "Samsung Mobile HD Link Interface"
#	depends on VIDEO_SAMSUNG
	default n
	help
	  This is a MHL v1 driver for Samsung S5PV210.
```

## drivers/media/video/samsung/tvout/Kconfig
```kconfig
#
# Configuration for TV driver
#

config VIDEO_TVOUT
	bool "Samsung TVOUT Driver"
	depends on VIDEO_SAMSUNG
	default y
	---help---
	  This is a TVOUT driver for Samsung S5P platform

config HDMI_CEC
	bool "HDMI CEC driver support."
	depends on VIDEO_TVOUT && (CPU_S5PV210 || CPU_S5PV310)
	default y
	---help---
	  This is a HDMI CEC driver for Samsung S5P platform.
	  Check dev node (major 10, minor 242)

config HDMI_HPD
	bool "HDMI HPD driver support."
	depends on VIDEO_TVOUT && (CPU_S5PV210 || CPU_S5PV310)
	default y
	---help---
	  This is a HDMI HPD driver for Samsung S5P platform.
	  Check dev node (major 10, minor 243)

config TV_FB
	bool "TVOUT frame buffer driver support."
	select FB_CFB_FILLRECT
	select FB_CFB_COPYAREA
	select FB_CFB_IMAGEBLIT

	depends on VIDEO_TVOUT && FB && (CPU_S5PV210 || CPU_S5PV310)
	default y
	---help---

config USER_ALLOC_TVOUT
	bool "Support pre allocated frame buffer memory."
	depends on VIDEO_TVOUT && TV_FB
	default y
	---help---
	  TV Driver doesn't allocate memory for frame buffer.
	  So, before enabling TV out, the frame buffer should be allocated.

config TV_FB_NUM
	int "Index of TVOUT frame buffer"
	depends on VIDEO_TVOUT && TV_FB && !USER_ALLOC_TVOUT
	default 5
	---help---

config TV_DEBUG
	bool "TVOUT driver debug message"
	depends on VIDEO_TVOUT
	default n

config VP_DEBUG
	bool "Video Processor debug message"
	depends on TV_DEBUG
	default n

config MIXER_DEBUG
	bool "Mixer debug message"
	depends on TV_DEBUG
	default n

config HDMI_DEBUG
	bool "HDMI debug message"
	depends on TV_DEBUG
	default n

config SDO_DEBUG
	bool "SDO(Composite) debug message"
	depends on TV_DEBUG
	default n

config HDCP_DEBUG
	bool "HDCP debug message"
	depends on TV_DEBUG
	default n

config CEC_DEBUG
	bool "CEC debug message"
	depends on TV_DEBUG
	default n

config HPD_DEBUG
	bool "HPD debug message"
	depends on TV_DEBUG
	default n
```

## drivers/mmc/Kconfig
```kconfig
#
# MMC subsystem configuration
#

menuconfig MMC
	tristate "MMC/SD/SDIO card support"
	depends on HAS_IOMEM
	help
	  This selects MultiMediaCard, Secure Digital and Secure
	  Digital I/O support.

	  If you want MMC/SD/SDIO support, you should say Y here and
	  also to your specific host controller driver.

config MMC_DEBUG
	bool "MMC debugging"
	depends on MMC != n
	help
	  This is an option for use by developers; most people should
	  say N here.  This enables MMC core and driver debugging.

config MMC_DISCARD
	bool "MMC discard support"
	depends on MMC != n
	help
	  If you want MMC discard support, you should say Y here

config MMC_DISCARD_MOVINAND
	bool "MMC discard extra funtions depended on MoviNAND support"
	depends on MMC_DISCARD != n
	help
	  If you want MMC discard support on MoviNAND, you should 
	  say Y here to be optimize

config MMC_DISCARD_MERGE
	bool "MMC discard is merged (v2.0)"
	depends on MMC_DISCARD != n
	help
	  If you want to merge blocks when discard is requested, you should 
	  say Y here. Discard regions are merged by rb_tree.

config MMC_DISCARD_DEBUG
	bool "MMC discard debugging"
	depends on MMC_DISCARD != n
	help
	  This is an option for use by developers; most people should
	  say N here.  This enables MMC discard debugging.
if MMC

source "drivers/mmc/core/Kconfig"

source "drivers/mmc/card/Kconfig"

source "drivers/mmc/host/Kconfig"

endif # MMC
```

## drivers/samsung/Kconfig
```kconfig
#
#
#

menuconfig SAMSUNG_MODULES
	tristate "Samsung Kernel Modules"
	default m
	help
	  Say Y to enable Samsung kernel modules. j4fs and param
	  modules are included.

menuconfig J4FS
	tristate "Samsung J4FS support"
	depends on SAMSUNG_MODULES
	default m
	help
	  Say Y to enable Samsung J4FS support.

menuconfig FM_SI4709
	tristate "Si4709 FM radio"
	depends on SAMSUNG_MODULES
	default m
	help
	  Say Y to enable Si4709 FM radio support.

menuconfig VIBETONZ
	tristate "Vibetonz"
	depends on SAMSUNG_MODULES
	default m
	help
	  Say Y to enable Vibetonz support.

menuconfig STORAGE
	tristate "Storage"
	depends on SAMSUNG_MODULES && SAMSUNG_PHONE_SVNET
	default m
	help
	  Say Y to enable DGS info support.

menuconfig LEVEL
	tristate "Level"
	depends on SAMSUNG_MODULES && SAMSUNG_PHONE_SVNET
	default m
	help
	  Say Y to enable Debug Level support.
```

## drivers/svnet/Kconfig
```kconfig
#
#
#

menuconfig SAMSUNG_PHONE_SVNET
	tristate "Samsung Phone Interface - SVN"
	default n
	---help---
		I love you.

#if SAMSUNG_PHONE_SVNET
#endif # SAMSUNG_PHONE_SVNET
```
