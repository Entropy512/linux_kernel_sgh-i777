## drivers/video/samsung/Kconfig
```kconfig
#
# S3C Video configuration
#

config FB_S3C
	tristate "S3C Framebuffer support"
	select FB_CFB_FILLRECT
	select FB_CFB_COPYAREA
	select FB_CFB_IMAGEBLIT
	depends on FB && (ARCH_S5PV210 || ARCH_S5PV310)
	default n
	help
	  This enables support for Samsung Display Controller (FIMD)

config FB_S3C_SPLASH_SCREEN
	bool "SPLASH_SCREEN on LCD"
	depends on FB_S3C
	default y

config FB_S3C_LCD_INIT
	bool "LCD init in kernel"
	depends on FB_S3C
	default y

config FB_S3C_DEBUG
	bool "S3C Framebuffer debug messages"
	depends on FB_S3C

config FB_S3C_TRACE_UNDERRUN
	bool "S3C Framebuffer FIFO underrun trace"
	depends on FB_S3C

config FB_S3C_DEFAULT_WINDOW
	int "Default Window (0-4)"
	depends on FB_S3C
	default "0"
	help
	  This indicates the default window number, and which is used as console framebuffer

config FB_S3C_NR_BUFFERS
	int "Number of frame buffers (1-3)"
	depends on FB_S3C
	default "1"
	help
	  This indicates the number of buffers for pan display,
	  1 means no pan display and
	  2 means the double size of video buffer will be allocated for default window

config FB_S3C_VIRTUAL
	bool "Virtual Screen"
	depends on FB_S3C
	default n
	help
	  This uses 1920 x 1080 virtual screen.

config FB_S3C_X_VRES
	int "xres_virtual"
	depends on FB_S3C && FB_S3C_VIRTUAL
	default "1920"
	help
	  This indicates var.xres_virtual which has to be bigger than var.xres.

config FB_S3C_Y_VRES
	int "yres_virtual"
	depends on FB_S3C && FB_S3C_VIRTUAL
	default "1080"
	help
	  This indicates var.yres_virtual which has to be bigger than var.yres.

config VIDEO_SAMSUNG_MEMSIZE_FIMD
	int "Memory size in kbytes for FIMD"
	depends on FB_S3C
	default "24576"

config FB_S3C_MDNIE
	bool "Samsung MDNIE"
	depends on FB_S3C
	depends on MACH_C1
	default "0"
	---help---
	  This enables support for Samsung MDNIE feature

config SUPPORT_UMP
	bool "Support UMP (Unified Memory Provider) for FIMD "
	depends on FB_S3C && VIDEO_UMP
	default y

choice
depends on FB_S3C
prompt "Select LCD Type"
default FB_S3C_TL2796
config FB_S3C_LTE480WV
	bool "LTE480WV"
	depends on MACH_SMDKV310 || MACH_SMDKC210 || MACH_SMDKV210 || MACH_SMDKC110
	help
	  This enables support for Samsung LTE480WV 4.8" WVGA LCD panel

config FB_S3C_HT101HD1
	bool "HT101HD1"
	depends on MACH_SMDKV310 || MACH_SMDKC210 || MACH_SMDKV210 || MACH_SMDKC110
	help
	  This enables support for HT101HD1 10.1" WXVGA(1366*768) LCD panel

config FB_S3C_WA101S
	bool "WA101S"
	depends on MACH_SMDKV310 || MACH_SMDKC210
	help
	  This enables support for 10.1" 1366*768 LCD panel

config FB_S3C_AMS369FG06
	bool "AMS369FG06"
	depends on MACH_SMDKV310 || MACH_SMDKC210
	select SPI
	select SPI_S3C64XX
	help
	  This enables support for Samsung AMS369FG06 3.7" WVGA AMOLED panel

config FB_S3C_LD9040
        bool "LD9040"
	depends on MACH_C1 && !MACH_C1_NA_SPR_EPIC2_REV00
	select LCD_CLASS_DEVICE
	select SPI
	select SPI_GPIO
	select SPI_BITBANG
	help
	  This enables support for Samsung LD9040 LCD panel

config FB_S3C_S6E63M0
        bool "S6E63M0"
	depends on MACH_C1 && MACH_C1_NA_SPR_EPIC2_REV00
	select LCD_CLASS_DEVICE
	select SPI
	select SPI_GPIO
	select SPI_BITBANG
	help
	  This enables support for Samsung S6E63M0 LCD panel

config FB_S3C_MIPI_LCD
	bool "MIPI LCD"
	depends on MACH_C1
	---help---
	  This enables support for Samsung MIPI LCD

config FB_S3C_S6D6AA0
        bool "S6D6AA0 MIPI LCD"
       depends on MACH_C1
       depends on MACH_C1 && FB_S3C_MIPI_LCD
        ---help---
          This enables support for Samsung S6D6AA0 MIPI LCD
 
config FB_S3C_S6E8AA0
       bool "S6E8AA0 MIPI LCD"
       depends on MACH_C1 && FB_S3C_MIPI_LCD
       ---help---
         This enables support for Samsung S6E8AA0 MIPI LCD

endchoice

config FB_S3C_V2
	tristate "S3C Framebuffer version 2 support"
	select FB_CFB_FILLRECT
	select FB_CFB_COPYAREA
	select FB_CFB_IMAGEBLIT
	select FRAMEBUFFER_CONSOLE_DETECT_PRIMARY
	depends on FB && (FB_S3C != y) && (FB_S3C != m) && (ARCH_S3C64XX || ARCH_S5P64XX || ARCH_S5PC1XX || ARCH_S5P6450)
	default n
	---help---
	  This enables support for Samsung Display Controller (FIMD)

config FB_S3C_V2_DEBUG
        bool "S3C Framebuffer version 2 debug messages"
        depends on FB_S3C_V2

config FB_S3C_V2_TRACE_UNDERRUN
        bool "S3C Framebuffer version 2 FIFO underrun trace"
        depends on FB_S3C_V2

config FB_S3C_V2_DEFAULT_WINDOW
	int "Default Window (0-4)"
	depends on FB_S3C_V2
	default "1"
	---help---
	  This indicates the default window number, and which is used as console framebuffer

config FB_S3C_V2_YPANSTEP
	int "Vertical Panning Step (0-2)"
	depends on FB_S3C_V2
	default "1"
	---help---
	  This indicates the number of vertical steps for pan display, 0 means no pan display and
	  1 means the double size of video buffer will be allocated for default window

choice
depends on FB_S3C_V2
prompt "Select LCD Type"
default FB_S3C_V2_LTE480WV
config FB_S3C_V2_LTE480WV
	bool "LTE480WV"
	---help---
	  This enables support for Samsung LTE480WV 4.8\" WVGA LCD panel

config FB_S3C_V2_TL2796
	bool "TL2796"
	---help---
	  This enables support for Samsung  TL2796 WVGA LCD panel
endchoice
```

## sound/soc/a1026/Kconfig
```kconfig
config SND_SOC_MIC_A1026
	bool "A1026 Voice Processor"
	depends on SND_SOC && I2C && SND_SOC_MC1N2
```

## sound/soc/s3c24xx/Kconfig
```kconfig
config SND_S3C24XX_SOC
	tristate "SoC Audio for the Samsung S3CXXXX chips"
	depends on ARCH_S3C2410 || ARCH_S3C64XX || ARCH_S5PC100 || ARCH_S5PV210 || ARCH_S5PV310
	select S3C64XX_DMA if ARCH_S3C64XX
	help
	  Say Y or M if you want to add support for codecs attached to
	  the S3C24XX AC97 or I2S interfaces. You will also need to
	  select the audio interfaces to support below.

config SND_S3C24XX_SOC_I2S
	tristate
	select S3C2410_DMA

config SND_S3C_I2SV2_SOC
	tristate

config SND_S3C2412_SOC_I2S
	tristate
	select SND_S3C_I2SV2_SOC
	select S3C2410_DMA

config SND_S3C64XX_SOC_I2S
	tristate
	select SND_S3C_I2SV2_SOC
	select S3C64XX_DMA

config SND_S3C64XX_SOC_I2S_V4
	tristate
	select SND_S3C_I2SV2_SOC
	select S3C64XX_DMA

config SND_SAMSUNG_SOC_I2S_V5
	tristate
	select SND_S3C64XX_SOC_I2S_V4

config SND_S3C_SOC_PCM
	tristate

config SND_S3C_SOC_AC97
	tristate
	select SND_SOC_AC97_BUS

config SND_SAMSUNG_SOC_SPDIF
	tristate
	select SND_SOC_SPDIF

config SND_S3C24XX_SOC_NEO1973_WM8753
	tristate "SoC I2S Audio support for NEO1973 - WM8753"
	depends on SND_S3C24XX_SOC && MACH_NEO1973_GTA01
	select SND_S3C24XX_SOC_I2S
	select SND_SOC_WM8753
	help
	  Say Y if you want to add support for SoC audio on smdk2440
	  with the WM8753.

config SND_S3C24XX_SOC_NEO1973_GTA02_WM8753
	tristate "Audio support for the Openmoko Neo FreeRunner (GTA02)"
	depends on SND_S3C24XX_SOC && MACH_NEO1973_GTA02
	select SND_S3C24XX_SOC_I2S
	select SND_SOC_WM8753
	help
	  This driver provides audio support for the Openmoko Neo FreeRunner
	  smartphone.

config SND_S3C24XX_SOC_JIVE_WM8750
	tristate "SoC I2S Audio support for Jive"
	depends on SND_S3C24XX_SOC && MACH_JIVE
	select SND_SOC_WM8750
	select SND_S3C2412_SOC_I2S
	help
	  Sat Y if you want to add support for SoC audio on the Jive.

config SND_S3C64XX_SOC_WM8580
	tristate "SoC I2S Audio support for WM8580 on SMDK64XX"
	depends on SND_S3C24XX_SOC && MACH_SMDK6410
	select SND_SOC_WM8580
	select SND_S3C64XX_SOC_I2S_V4
	help
	  Say Y if you want to add support for SoC audio on the SMDK6410.

config SND_SOC_SMDK_WM8994_I2S
	tristate "SoC I2S Audio support for WM8994 on SMDK"
	depends on SND_S3C24XX_SOC && (MACH_SMDKV310 || MACH_SMDKC210)
	select SND_SOC_WM8994
	select SND_SOC_WM_HUBS
	select SND_SAMSUNG_SOC_I2S_V5
	default y
	help
	  Say Y if you want to add support for SoC audio on the SMDK.

config SND_SOC_SMDK_WM8994_MASTER
	bool "WM8994 Master Mode"
	depends on SND_SOC_SMDK_WM8994_I2S
	default y

config SND_SOC_C1_MC1N2
	tristate "SoC I2S Audio support for MC1N2 on C1"
	depends on SND_S3C24XX_SOC && MACH_C1
	select SND_SOC_MC1N2
	select SND_SAMSUNG_SOC_I2S_V5
	help
	  Say Y if you want to add support for SoC audio on the SMDK.

config  S5P_INTERNAL_DMA
	bool "IIS operation with Internal DMA"
	depends on SND_SOC_SMDK_WM8994_I2S || SND_SOC_C1_MC1N2
	default y
	help
	  Say Y for IIS to operate with Internal DMA(IIS's own DMA)

config SND_S5P_RP
	bool "SRP Audio support via Internal DMA"
	depends on S5P_INTERNAL_DMA
	default n
	help
	  Say Y if you want to add support for SRP Audio.

config AUDIO_SAMSUNG_MEMSIZE_SRP
	int "Memory size in kbytes for SRP Audio"
	depends on SND_S5P_RP
	default "1024"

config SND_S5P_RP_DEBUG
	bool "Enable debug message for SRP Audio"
	depends on SND_S5P_RP
	default n
	help
	  Say Y if you want to add debug message for SRP Audio.

config SND_SOC_SMDK_WM8994_PCM
	tristate "SoC PCM Audio support for WM8994 on SMDK"
	depends on SND_S3C24XX_SOC && (MACH_SMDKV310 || MACH_SMDKC210)
	select SND_SOC_WM8994
	select SND_SOC_WM_HUBS
	select SND_S3C_SOC_PCM
	help
	  Say Y if you want to add support for SoC audio on the SMDK.

config SND_S3C24XX_SOC_SMDK2443_WM9710
	tristate "SoC AC97 Audio support for SMDK2443 - WM9710"
	depends on SND_S3C24XX_SOC && MACH_SMDK2443
	select S3C2410_DMA
	select AC97_BUS
	select SND_SOC_AC97_CODEC
	select SND_S3C_SOC_AC97
	help
	  Say Y if you want to add support for SoC audio on smdk2443
	  with the WM9710.

config SND_S3C24XX_SOC_LN2440SBC_ALC650
	tristate "SoC AC97 Audio support for LN2440SBC - ALC650"
	depends on SND_S3C24XX_SOC && ARCH_S3C2410
	select S3C2410_DMA
	select AC97_BUS
	select SND_SOC_AC97_CODEC
	select SND_S3C_SOC_AC97
	help
	  Say Y if you want to add support for SoC audio on ln2440sbc
	  with the ALC650.

config SND_S3C24XX_SOC_S3C24XX_UDA134X
	tristate "SoC I2S Audio support UDA134X wired to a S3C24XX"
       	depends on SND_S3C24XX_SOC && ARCH_S3C2410
       	select SND_S3C24XX_SOC_I2S
	select SND_SOC_L3
       	select SND_SOC_UDA134X

config SND_S3C24XX_SOC_SIMTEC
	tristate
	help
	  Internal node for common S3C24XX/Simtec suppor

config SND_S3C24XX_SOC_SIMTEC_TLV320AIC23
	tristate "SoC I2S Audio support for TLV320AIC23 on Simtec boards"
	depends on SND_S3C24XX_SOC && ARCH_S3C2410
	select SND_S3C24XX_SOC_I2S
	select SND_SOC_TLV320AIC23
	select SND_S3C24XX_SOC_SIMTEC

config SND_S3C24XX_SOC_SIMTEC_HERMES
	tristate "SoC I2S Audio support for Simtec Hermes board"
	depends on SND_S3C24XX_SOC && ARCH_S3C2410
	select SND_S3C24XX_SOC_I2S
	select SND_SOC_TLV320AIC3X
	select SND_S3C24XX_SOC_SIMTEC

config SND_SOC_SMDK_WM9713
	tristate "SoC AC97 Audio support for SMDK with WM9713"
	depends on SND_S3C24XX_SOC && (MACH_SMDK6410 || MACH_SMDKC100 || MACH_SMDKV210 || MACH_SMDKC110 \
			|| MACH_SMDKV310 || MACH_SMDKC210)
	select SND_SOC_WM9713
	select SND_S3C_SOC_AC97
	help
	  Sat Y if you want to add support for SoC audio on the SMDK.

config SND_S3C64XX_SOC_SMARTQ
	tristate "SoC I2S Audio support for SmartQ board"
	depends on SND_S3C24XX_SOC && MACH_SMARTQ
	select SND_S3C64XX_SOC_I2S
	select SND_SOC_WM8750

config SND_SOC_SMDK_SPDIF
	tristate "SoC S/PDIF Audio support on SMDK"
	depends on SND_S3C24XX_SOC && (MACH_SMDKV310 || MACH_SMDKC210)
	select SND_SAMSUNG_SOC_SPDIF
	help
	  Say Y if you want to add support for SoC S/PDIF audio on the SMDK.
```
